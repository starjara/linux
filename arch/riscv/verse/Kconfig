## arch/riscv/verse/Kconfig
```kconfig
# SPDX-License-Identifier: GPL-2.0
#
# VERSE configuration
#

source "virt/verse/Kconfig"

menuconfig VIRTUALIZATION
	bool "Virtualization"
	help
	  Say Y here to get to see options for using your Linux host to run
	  other operating systems inside virtual machines (guests).
	  This option alone does not add any kernel code.

	  If you say N, all options in this submenu will be skipped and
	  disabled.

if VIRTUALIZATION

config VERSE
	tristate "RISC-V VERSE"
	depends on RISCV_SBI && MMU
	help
	  Support hosting virtualized guest machines.

	  If unsure, say N.

endif # VIRTUALIZATION
```

## virt/mini/Kconfig
```kconfig
# SPDX-License-Identifier: GPL-2.0
# KVM common configuration items and defaults

config HAVE_MINI
       bool

config HAVE_MINI_DIRTY_RING
       bool
```

## virt/verse/Kconfig
```kconfig
# SPDX-License-Identifier: GPL-2.0
# VERSE common configuration items and defaults

config HAVE_VERSE
       bool
```
